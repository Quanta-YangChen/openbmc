## vscode-bitbake-build/conf/bblayers.conf
```bitbake
# POKY_BBLAYERS_CONF_VERSION is increased each time build/conf/bblayers.conf
# changes incompatibly
POKY_BBLAYERS_CONF_VERSION = "2"

BBPATH = "${TOPDIR}"
BBFILES ?= ""

BBLAYERS ?= " \
  /home/obliging/project/minerva/openbmc-self/openbmc/meta \
  /home/obliging/project/minerva/openbmc-self/openbmc/meta-poky \
  /home/obliging/project/minerva/openbmc-self/openbmc/meta-yocto-bsp \
  "
```
